/*
 * Copyright (c) 2022 GEIST
 *
 * SPDX-License-Identifier: MIT
 */

#include "klor.dtsi"

/ {
	chosen {
		zmk,kscan = &kscan0;
        };

	kscan0: kscan {
		compatible = "zmk,kscan-gpio-matrix";
		diode-direction = "col2row";
                col-gpios
                        = <&pro_micro 19 GPIO_ACTIVE_HIGH>
                        , <&pro_micro 18 GPIO_ACTIVE_HIGH>
                        , <&pro_micro 15 GPIO_ACTIVE_HIGH>
                        , <&pro_micro 14 GPIO_ACTIVE_HIGH>
                        , <&pro_micro 16 GPIO_ACTIVE_HIGH>
                        , <&pro_micro 10 GPIO_ACTIVE_HIGH>
                        ;
                row-gpios
                        = <&pro_micro 5 (GPIO_ACTIVE_HIGH | GPIO_PULL_DOWN)>
                        , <&pro_micro 6 (GPIO_ACTIVE_HIGH | GPIO_PULL_DOWN)>
                        , <&pro_micro 7 (GPIO_ACTIVE_HIGH | GPIO_PULL_DOWN)>
                        , <&pro_micro 8 (GPIO_ACTIVE_HIGH | GPIO_PULL_DOWN)>
                        ;
	};
};

&left_encoder {
        a-gpios = <&pro_micro 20 (GPIO_ACTIVE_HIGH | GPIO_PULL_UP)>;
        b-gpios = <&pro_micro 21 (GPIO_ACTIVE_HIGH | GPIO_PULL_UP)>;
	status = "okay";
};

// vim: expandtab softtabstop=4 shiftwidth=4 filetype=devicetree
