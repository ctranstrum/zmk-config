## config/boards/shields/klor/Kconfig.defconfig
```kconfig
if SHIELD_KLOR_DONGLE

    config ZMK_KEYBOARD_NAME
        default "KLOR"

    config ZMK_SPLIT_ROLE_CENTRAL
        default y

    config ZMK_USB
        default y

endif



if SHIELD_KLOR_LEFT || SHIELD_KLOR_RIGHT || SHIELD_KLOR_DONGLE

    config ZMK_SPLIT
        default y

    config ZMK_BLE
        default y

endif
```

## config/boards/shields/kyria/Kconfig.defconfig
```kconfig
if SHIELD_KYRIA_DONGLE

config ZMK_KEYBOARD_NAME
    default "Kyria"

config ZMK_SPLIT_ROLE_CENTRAL
    default y

config ZMK_USB
    default y

endif

if SHIELD_KYRIA_LEFT || SHIELD_KYRIA_RIGHT || SHIELD_KYRIA_DONGLE

config ZMK_SPLIT
    default y

config ZMK_BLE
    default y

endif
```

## config/boards/shields/kyria/Kconfig.shield
```kconfig
config SHIELD_KYRIA_LEFT
    def_bool $(shields_list_contains,kyria_left)

config SHIELD_KYRIA_RIGHT
    def_bool $(shields_list_contains,kyria_right)

config SHIELD_KYRIA_DONGLE
    def_bool $(shields_list_contains,kyria_dongle)
```

## config/boards/shields/seeed_round_display/Kconfig.defconfig
```kconfig
# Copyright (c) 2024 The ZMK Contributors
# SPDX-License-Identifier: MIT

if SHIELD_SEEED_ROUND_DISPLAY

choice ZMK_DISPLAY_STATUS_SCREEN
    default ZMK_DISPLAY_STATUS_SCREEN_CUSTOM
endchoice

config ZMK_DISPLAY_STATUS_SCREEN_CUSTOM
    select LV_USE_LABEL
    select LV_USE_IMG
    select LV_USE_CANVAS
    select LV_USE_ANIMIMG
    select LV_USE_ANIMATION
    select LV_USE_LINE
    select LV_FONT_MONTSERRAT_14
    select ZMK_WPM

choice ZMK_DISPLAY_WORK_QUEUE
    default ZMK_DISPLAY_WORK_QUEUE_DEDICATED
endchoice

config LV_Z_MEM_POOL_SIZE
    default 8192

config LV_Z_VDB_SIZE
    default 64

config LV_DPI_DEF
    default 188

config LV_Z_BITS_PER_PIXEL
    default 16

choice LV_COLOR_DEPTH
    default LV_COLOR_DEPTH_16
endchoice

endif
```

## config/boards/shields/seeed_round_display/Kconfig.shield
```kconfig
# Copyright (c) 2024 The ZMK Contributors
# SPDX-License-Identifier: MIT

config SHIELD_SEEED_ROUND_DISPLAY
	def_bool $(shields_list_contains,seeed_round_display)
```

## config/boards/shields/trikyria/Kconfig.defconfig
```kconfig
if SHIELD_TRIKYRIA_DONGLE || SHIELD_TRIKYRIA_DONGLE_OLED

config ZMK_KEYBOARD_NAME
    default "Dongled Kyria"

config ZMK_SPLIT_ROLE_CENTRAL
    default y

config ZMK_USB
    default y

endif

if SHIELD_TRIKYRIA_LEFT || SHIELD_TRIKYRIA_RIGHT || SHIELD_TRIKYRIA_DONGLE || SHIELD_TRIKYRIA_DONGLE_OLED

config ZMK_SPLIT
    default y

config ZMK_BLE
    default y

endif
```

## config/boards/shields/trikyria/Kconfig.shield
```kconfig
config SHIELD_TRIKYRIA_LEFT
    def_bool $(shields_list_contains,trikyria_left)

config SHIELD_TRIKYRIA_RIGHT
    def_bool $(shields_list_contains,trikyria_right)

config SHIELD_TRIKYRIA_DONGLE
    def_bool $(shields_list_contains,trikyria_dongle)

config SHIELD_TRIKYRIA_DONGLE_OLED
    def_bool $(shields_list_contains,trikyria_dongle_oled)
```

## config/boards/shields/xiao_round_display/Kconfig.defconfig
```kconfig
# Copyright (c) 2024 Nicolas Goualard <nicolas.goualard@sfr.fr>
# SPDX-License-Identifier: Apache-2.0

if SHIELD_XIAO_ROUND_DISPLAY

choice ZMK_DISPLAY_STATUS_SCREEN
    default ZMK_DISPLAY_STATUS_SCREEN_CUSTOM
endchoice

config ZMK_DISPLAY_STATUS_SCREEN_CUSTOM
    select LV_USE_LABEL
    select LV_USE_IMG
    select LV_USE_CANVAS
    select LV_USE_ANIMIMG
    select LV_USE_ANIMATION
    select LV_USE_LINE
    select LV_FONT_UNSCII_8
    select ZMK_WPM

choice ZMK_DISPLAY_WORK_QUEUE
    default ZMK_DISPLAY_WORK_QUEUE_DEDICATED
endchoice

config LV_Z_MEM_POOL_SIZE
    default 8192

config LV_Z_VDB_SIZE
    default 64

config LV_DPI_DEF
    default 148

config INPUT
	default y

choice LV_COLOR_DEPTH
	default LV_COLOR_DEPTH_16
endchoice

config LV_COLOR_16_SWAP
	default y

endif # SHIELD_XIAO_ROUND_DISPLAY
```

## config/boards/shields/xiao_round_display/Kconfig.shield
```kconfig
# Copyright (c) 2024 Nicolas Goualard <nicolas.goualard@sfr.fr>
# SPDX-License-Identifier: Apache-2.0

config SHIELD_XIAO_ROUND_DISPLAY
	def_bool $(shields_list_contains,xiao_round_display)
```

## config/west.yml
```yaml
manifest:
  remotes:
    - name: zmkfirmware
      url-base: https://github.com/zmkfirmware
    - name: Nick-Munnich
      url-base: https://github.com/Nick-Munnich
    - name: ctranstrum
      url-base: https://github.com/ctranstrum
    - name: caksoylar
      url-base: https://github.com/caksoylar
    - name: carrefinho
      url-base: https://github.com/carrefinho
    - name: englmaxi
      url-base: https://github.com/englmaxi
    - name: t-ogura
      url-base: https://github.com/t-ogura

  projects:
    - name: zmk
      remote: zmkfirmware
      # The revision needs to match in .github/workflows/build.yml
      revision: v0.3
      import: app/west.yml
    # - name: zmk
    #   remote: Nick-Munnich
    #   revision: kconfig-fix
    #   import: app/west.yml
    - name: chuck
      remote: ctranstrum
      revision: zmk
    - name: lintilla
      remote: ctranstrum
      revision: zmk
    - name: zmk-rgbled-widget
      remote: caksoylar
      revision: main
    - name: prospector-zmk-module
      remote: carrefinho
      revision: main
    - name: zmk-dongle-display
      remote: englmaxi
      revision: main
    - name: prospector-zmk-module
      remote: t-ogura
      revision: v1.1.1
      path: modules/prospector-zmk-module

  self:
    path: config
```
